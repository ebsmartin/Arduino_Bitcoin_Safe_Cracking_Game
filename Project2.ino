/*
 * Eric Martin
 * Project 2
 * Date: 09/29/2021
 * Class: IDEA 310L @ CSU
 * 
 * Description:
 * 
 *    A game where you use a rotary encoder to attempt to crack a lock by listening for a difference in sound
 *    in each rotational 'click' generated by a piezoelectric transducer. The display provides information,
 *    instructions, and if you are succesful, sensitive information! But beware, if you fail to crack the lock
 *    bad news is in store!
 *
 * Circuit:
 * 
 * - Pin 11 : ohm piezoelectric transducer speaker
 * - Pin 10 : Green input for RBG LED
 * - Pin 9  : Red input for RGB LED
 * - Pin 4  : Rotary Encoder Switch
 * - Pin 3  : Rotary Encoder Clock
 * - Pin 2  : Rotary Encoder Data
 * - CLK    : LCD clock
 * - SDA    : LCD data
 * - 5V     : power for LCD and Rotary Encoder
 * 
 */

 
#include <Wire.h> 
#include <LiquidCrystal_I2C.h>

LiquidCrystal_I2C lcd(0x27,16,2);  // set the LCD address to 0x27 for a 16 chars and 2 line display

//Tones for Piezo Button
#define NOTE_C4  262               // Note for the dial 'clicks'
#define NOTE_A4  440               // Note for the 'target' click

//LED
const int LEDR = 9;                // Red light pin for RGB bulb
const int LEDG = 10;               // Green light pin for RGB bulb

//Rotary Encoder
const int RotaryDT = 2;            // data
const int RotaryCLK = 3;           // clock
const int RotarySW = 4;            // switch

//Buzzer
const int BUZZER_PIN = 11;         // buzzer

//Globals
bool   passEntered = false;        // is a password stored?
String password = "";              // string for password to live (not encrypted for this)
int    passNum1;                   // store first num in pass as an int
int    passNum2;                   // store second num in pass as an int
int    passNum3;                   // store third num in pass as an int
bool   passVerified = false;       // is password verfied?
bool   gameStarted = false;        // has the game begun? 
bool   gameOver = false;           // is the game over?
bool   gameWin = false;            // did you win?
bool   gameLose = false;           // did you lose?

// tracking for rotary counter use
int    Rotarycounter = 0; 
int    RotaryState;
int    RotaryLastState;  
int    RotaryButtonState = 1;

// for use in startGame() function
String currentGuess = "";          // current guess (concatenated string of numbers and spaces)
int    currGuessNum = 0;           // Number of guesses


void setup()
{
  //LCD
  lcd.init();                      // initialize the lcd 
  lcd.backlight();                 // initialize the lcd backlight

  //LED
  pinMode(LEDR, OUTPUT);           // state that pin 9 is output for LEDR
  pinMode(LEDG, OUTPUT);           // state that pin 10 is output for LEDG

  //Rotary Encoder
  pinMode (RotaryDT,INPUT);
  pinMode (RotaryCLK,INPUT);
  pinMode (RotarySW, INPUT);
  RotaryLastState = digitalRead(RotaryCLK); 

  //Buzzer
  pinMode(BUZZER_PIN, OUTPUT);

  //Other
  Serial.begin(9600);              // begin serial communication
  randomSeed(analogRead(0));       // generate a randomized seed
}

void loop()
{
  // function to prompt user for password
 askForPass();
  
  // when characters arrive over the serial port verify password
 verifyPass();

  // promt user with new instructions now that pass is stored
 gameInstructions();

  // begin the game
 startGame();

  // run game over sequence
 endRoutine();

}

// function to set RGB light
void RGB_color(int redVal, int greenVal){   // blue not needed. Saved a pin space
  analogWrite(LEDR, redVal);
  analogWrite(LEDG, greenVal);
}

// function to ask for password and display instructions
void askForPass(){
  if(!passEntered ){                   // if password isn't saved, prompt user
    while(Serial.available() == 0){    // if no serial input detected, loop
       lcd.setCursor(0,0);             // print on top line
       lcd.print("Bitcoin Safe"); 
       delay(3000);
       lcd.clear();
       lcd.setCursor(0,0);             // print on top line
       lcd.print("Enter Password:"); 
       lcd.setCursor(0,1);             // print on bottom line
       lcd.print("ex: 99 34 0");
       delay(3000);
       lcd.clear();
       lcd.setCursor(0,0);             // print on top line
       lcd.print("Enter Password:");
       lcd.setCursor(0,1);             // print on bottom line
       lcd.print("0 <= X < 100");
       delay(3000);
       lcd.clear();
       lcd.setCursor(0,0);             // print on top line
       lcd.print("Type 'random'"); 
       lcd.setCursor(0,1);             // print on bottom line
       lcd.print("for random pass");
       delay(4000);
       lcd.clear();
    }
  }
}

//function to verify password
void verifyPass(){
  
  int index = 0;  // local variable to store index values below
  
  if (Serial.available() && !passVerified) {  // check for serial input and if pass was already verified
    // wait a bit for the entire message to arrive
    delay(100);
    // clear the screen
    lcd.clear();
    // read all the available characters
    while (Serial.available() > 0 && passEntered == false) {
      // display each character to the LCD
      char currRead = Serial.read();
      if(currRead != '\n'){  // ensure we do not add newline chars to password
        // if the char starts with r or R we will consider it random
        if((index == 0) && (currRead == 'r' || currRead == 'R')){
          String randPass = "";
          passNum1 = random(0,100);
          randPass.concat(passNum1);
          randPass.concat(" ");
          passNum2 = random(0,100);
          randPass.concat(passNum2);
          randPass.concat(" ");
          passNum3 = random(0,100);
          randPass.concat(passNum3);
          password = randPass;
          passEntered = true;
          index = 8; // set index to 8 to pass pass length check after loop exits
          break;
        }
        if((index == 2 || index == 5) && (currRead != ' ')){
          RGB_color(255, 0);
          lcd.clear();
          lcd.setCursor(0,0);
          lcd.print("INPUT ERROR!");
          lcd.setCursor(0,1);
          lcd.print("Spaces needed");
          delay(4000);
          exit(1);
        }
        if(index > 7){
          RGB_color(255, 0);
          lcd.clear();
          lcd.setCursor(0,0);
          lcd.print("INPUT ERROR!");
          lcd.setCursor(0,1);
          lcd.print("Too many Chars");
          delay(4000);
          exit(1);
        }
        lcd.setCursor(0,0);
        password.concat(currRead); 
        index++;
      }
    }
    if(index != 8 && passEntered == false){
      RGB_color(255, 0);
      lcd.clear();
      lcd.setCursor(0,0);
      lcd.print("INPUT ERROR!");
      lcd.setCursor(0,1);
      lcd.print("Too few chars");
      delay(4000);
      exit(1);
    }
    RGB_color(0, 255);
    lcd.clear();
    lcd.setCursor(0,0);
    lcd.print("Passwrd Accepted");
    lcd.setCursor(0,1);
    lcd.print(password);
    delay(2000);
    lcd.clear();
    lcd.setCursor(0,0);
    lcd.print("Passwrd Stored");
    lcd.setCursor(0,1);
    lcd.print("********");
    passEntered = true;
    delay(2000);
  }
  RGB_color(0,0);
  Serial.end();
  Serial.begin(9600);
  lcd.clear();
  passVerified = true;
}

void gameInstructions(){

  if(passVerified && !gameStarted){      // if password isn't saved or game has already begun, do not run
    while(Serial.available() == 0){    // if no serial input detected, loop
       lcd.setCursor(0,0);             // print on top line
       lcd.print("Instructions!"); 
       lcd.setCursor(0,1);             // print on bottom line
       lcd.print("Crack the pass");
       delay(3000);
       lcd.clear();
       lcd.setCursor(0,0);             // print on top line
       lcd.print("Use the knob and");
       lcd.setCursor(0,1);             // print on bottom line
       lcd.print("listen for clues");
       delay(3000);
       lcd.clear();
       lcd.setCursor(0,0);             // print on top line
       lcd.print("Press the knob"); 
       lcd.setCursor(0,1);             // print on bottom line
       lcd.print("to enter a value");
       delay(3000);
       lcd.clear();
       lcd.print("Type Start"); 
       lcd.setCursor(0,1);             // print on bottom line
       lcd.print("to begin...");
       delay(3000);
       lcd.clear();
    }
    if (Serial.available() && passVerified && !gameStarted) {  // check for serial input and if pass was already verified
    // wait a bit for the entire message to arrive
    delay(100);
    // clear the screen
    lcd.clear();
    // read all the available characters
    while (Serial.available() > 0) {
      // display each character to the LCD
      char currRead = Serial.read();
      if(currRead != '\n'){  // ensure we do not add newline chars to password
        // if the char starts with r or R we will consider it random
        if(currRead == 's' || currRead == 'S'){ // just looking for an S to start
          break;
        }   
      }
    }
    RGB_color(0, 255);
    lcd.clear();
    lcd.setCursor(0,0);
    lcd.print("Begin!");
    lcd.setCursor(0,1);
    lcd.print("crack the pass");
    delay(4000);
    lcd.clear();
    lcd.setCursor(0,0);
    lcd.print("Begin!");
    lcd.setCursor(0,1);
    lcd.print("** ** **");
    gameStarted = true;
    delay(4000);
  }
  RGB_color(0,0);
  Serial.end();
  Serial.begin(9600);
  lcd.clear();

  }
}

void startGame(){
  if(!gameOver){
    lcd.setCursor(0,0);
    lcd.print("Position: ");
    
    while(!gameOver){
      RotaryState = digitalRead(RotaryCLK); // Read CLK
      // If CLK changed, that means a Pulse has occurred
      if ((RotaryState != RotaryLastState) && RotaryState){     
        // If RotaryDT is different => clockwise
        if (digitalRead(RotaryDT) != RotaryState) { 
          if(Rotarycounter < 99){
              if((currGuessNum == 0) && (Rotarycounter == (passNum1))){
                tone(11, 466 , 20);
                Rotarycounter ++;
              }else if((currGuessNum == 1) && (Rotarycounter == passNum2)){
                Rotarycounter ++;
                tone(11, 466 , 20);
              }else if((currGuessNum == 2) && (Rotarycounter == passNum3)){
                Rotarycounter ++;
                tone(11, 466 , 20);
              }else{
                tone(11, NOTE_C4 , 2);
                Rotarycounter ++;
                
              }
          }
        }else{
          if(Rotarycounter > 0){
            if((currGuessNum == 0) && (Rotarycounter == passNum1)){
                tone(11, 466 , 20);
                Rotarycounter --;
            }else if((currGuessNum == 1) && (Rotarycounter == passNum2)){
                tone(11, 466 , 20);
                Rotarycounter --;
            }else if((currGuessNum == 2) && (Rotarycounter == passNum3)){
                tone(11, 466 , 20);
                Rotarycounter --;
            }else{
                tone(11, NOTE_C4 , 2);
                Rotarycounter --;
            }
          }
        }  
        lcd.clear();
        Serial.print("Position: ");
        lcd.setCursor(0,1);
        lcd.print(Rotarycounter);
        delay(100);
        Serial.println(Rotarycounter);
      }
      RotaryButtonState = digitalRead(RotarySW);
      if(RotaryButtonState == 0){
        currGuessNum++;
        currentGuess.concat(Rotarycounter);
        if(!(currGuessNum == 3)){
          currentGuess.concat(" ");
        }
        lcd.clear();
        lcd.setCursor(0,0);
        lcd.print("Input Saved");
        Serial.print("Input Saved: ");
        lcd.setCursor(0,1);
        lcd.print(currentGuess);
        delay(3000);
        RotaryButtonState = digitalRead(RotarySW);
      }
      if(currGuessNum == 3){
        checkWin();
      }
      RotaryLastState = RotaryState; // Remember CLK
    }
  }
}

// function to check if the user has won the game and guess the password correctly or not
void checkWin(){
  gameOver = true;
  if(password.equals(currentGuess)){
    lcd.clear();
    lcd.setCursor(0,0);
    lcd.print("Access Granted");
    delay(3000);
    RGB_color(0, 255);
    lcd.clear();
    lcd.setCursor(0,0);
    lcd.print("Wallet Passwrd:");
    lcd.setCursor(0,1);
    lcd.print("S3cr3tP4SSWrD!!!");
    delay(4000);
    lcd.clear();
    lcd.setCursor(0,0);
    lcd.print("Exodus Wallet");
    lcd.setCursor(0,1);
    lcd.print("Recovery Phrase:");
    delay(4000);
    lcd.clear();
    lcd.setCursor(0,0);
    lcd.print("Tin Yarrow Corgi");
    lcd.setCursor(0,1);
    lcd.print("Teddy Fish Zebra");
    delay(4000);
    lcd.clear();
    lcd.setCursor(0,0);
    lcd.print("Gourd Spray Nail");
    lcd.setCursor(0,1);
    lcd.print("Fox Amber Frail");
    delay(4000);
    lcd.clear();
    lcd.setCursor(0,0);
    lcd.print("Yurt Scrum Crash");
    lcd.setCursor(0,1);
    lcd.print("Treasure Ghost");
    delay(4000);
    lcd.clear();
    lcd.setCursor(0,0);
    lcd.print("Keep this phrase");
    lcd.setCursor(0,1);
    lcd.print("safe. Goodbye");
    delay(4000);
    gameWin = true;
  }else{
    tone(11, 600, 3000);
    tone(11, 700, 3000);
    tone(11, 600, 3000);
    tone(11, 700, 3000);
    lcd.clear();
    lcd.setCursor(0,0);
    lcd.print("Incorrect Pass");
    lcd.setCursor(0,1);
    lcd.print("Picture taken");
    RGB_color(255, 0);
    delay(3000);
    lcd.clear();
    lcd.setCursor(0,0);
    lcd.print("NFC Data");
    lcd.setCursor(0,1);
    lcd.print("Collected!");
    delay(4000);
    RGB_color(255, 0);
    gameLose = true;
  }
}

// function to play ending sequence
void endRoutine(){ 
    if(gameOver && gameWin){
      RGB_color(0, 255);
      lcd.clear();
      lcd.setCursor(0,0);
      lcd.print("Current Balance");
      lcd.setCursor(0,1);
      lcd.print("1362 BTC 53 ETH");
      delay(4000);
      lcd.clear();
      lcd.setCursor(0,0);
      lcd.print("Withdraw? Y or N");
      delay(3000);
    }
    if(gameOver && gameLose){
      RGB_color(255, 0);
      tone(11, 600, 3000);
      tone(11, 700, 3000);
      tone(11, 600, 3000);
      lcd.clear();
      lcd.setCursor(0,0);
      lcd.print("Police Inbound");
      lcd.setCursor(0,1);
      lcd.print("GPS Tracked!");
      delay(4000);
      lcd.clear();
      lcd.setCursor(0,0);
      lcd.print("Goodbye Theif!");
      delay(3000);
    }
}

  
